## boards/DJI_A/DJI_A_DEFAULT/board.yml
```yaml
board:
  name: DJI_A_DEFAULT
  full_name: libzr DJI_A (STM32F427IIH6)
  vendor: libzr
  socs:
    - name: stm32f427xx
```

## boards/DJI_C/DJI_C_DEFAULT/Kconfig.DJI_C_DEFAULT
```kconfig
# Copyright (c) 2026 libzr
# SPDX-License-Identifier: Apache-2.0

config BOARD_DJI_C_DEFAULT
	select SOC_STM32F407XG
```

## boards/DJI_C/DJI_C_DEFAULT/board.yml
```yaml
board:
  name: DJI_C_DEFAULT
  full_name: libzr DJI_C (STM32F407IGH6)
  vendor: libzr
  socs:
    - name: stm32f407xx
```

## boards/DM_MC02/DM_MC02_DEFAULT/Kconfig.DM_MC02_DEFAULT
```kconfig
# Copyright (c) 2026 libzr
# SPDX-License-Identifier: Apache-2.0

config BOARD_DM_MC02_DEFAULT
	select SOC_STM32H723XX
```

## boards/DM_MC02/DM_MC02_DEFAULT/board.yml
```yaml
board:
  name: DM_MC02_DEFAULT
  full_name: libzr DM_MC02 (STM32H723VGT6)
  vendor: libzr
  socs:
    - name: stm32h723xx
```
